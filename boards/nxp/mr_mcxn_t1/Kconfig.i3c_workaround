## boards/nxp/mr_mcxn_t1/Kconfig.i3c_workaround
```kconfig
config MCXN_T1_I3C_WORKAROUND
	bool "Enable I3C workaround"
	default y
	select USB_DEVICE_STACK_NEXT
	select CDC_ACM_SERIAL_INITIALIZE_AT_BOOT
	select SERIAL
	select CONSOLE
	select UART_CONSOLE
	select UART_LINE_CTRL
	imply I2C

configdefault USBD_CDC_ACM_LOG_LEVEL
	default 0
```

## boards/nxp/mr_mcxn_t1/board.yml
```yaml
board:
  name: mr_mcxn_t1
  full_name: NXP X-MR-MCXN-T1
  vendor: nxp
  socs:
  - name: mcxn947
    variants:
    - name: qspi
      cpucluster: 'cpu0'
```

## boards/nxp/mr_vmu_tropic/Kconfig.defconfig
```kconfig
# NXP MR-VMU-Tropic board

# Copyright 2018,2023 NXP
# SPDX-License-Identifier: Apache-2.0

if BOARD_MR_VMU_TROPIC

if NETWORKING

config NET_L2_ETHERNET
	default y

endif # NETWORKING

endif # BOARD_MR_VMU_TROPIC
```

## boards/nxp/mr_vmu_tropic/Kconfig.mr_vmu_tropic
```kconfig
# Copyright (c) 2018, NXP
# SPDX-License-Identifier: Apache-2.0

config BOARD_MR_VMU_TROPIC
	select SOC_PART_NUMBER_MIMXRT1064DVL6A
	select BOARD_EARLY_INIT_HOOK
	select MCUX_XBARA
	select LED
	select LED_PWM
```

## boards/nxp/mr_vmu_tropic/board.yml
```yaml
board:
  name: mr_vmu_tropic
  full_name: NXP MR-VMU-Tropic
  vendor: nxp
  socs:
    - name: mimxrt1064
```
